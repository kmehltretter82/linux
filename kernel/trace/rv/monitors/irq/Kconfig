## kernel/trace/rv/monitors/irq/Kconfig
```kconfig
# SPDX-License-Identifier: GPL-2.0-only
#
config RV_MON_IRQ
	depends on RV
	bool "irq monitor"
	help
	  Enable the container for monitors which check IRQ execution
	  context and ordering. Individual monitors can compare hardirq,
	  softirq, and scheduler events with the kernel's recorded execution
	  context.

	  For further information, see:
	    Documentation/trace/rv/monitor_irq.rst
```

## kernel/trace/rv/monitors/irqentry/Kconfig
```kconfig
# SPDX-License-Identifier: GPL-2.0-only
#
config RV_MON_IRQENTRY
	depends on RV
	bool "irqentry monitor"
	help
	  Enable the container for monitors which check IRQ-entry execution
	  context and ordering. Individual monitors can compare hardirq,
	  softirq, and scheduler events with the kernel's recorded execution
	  context.

	  For further information, see:
	    Documentation/trace/rv/monitor_irqentry.rst
```

## kernel/trace/rv/monitors/irqexit/Kconfig
```kconfig
# SPDX-License-Identifier: GPL-2.0-only
#
config RV_MON_IRQEXIT
	depends on RV
	depends on RV_MON_IRQENTRY
	default y
	select HA_MON_EVENTS_ID
	bool "irqexit monitor"
	help
	  Verify that IRQ-exit scheduling starts outside hardirq context
	  with interrupts disabled and returns to its original task.

	  For further information, see:
	    Documentation/trace/rv/monitor_irqentry.rst
```

## kernel/trace/rv/monitors/irqstate/Kconfig
```kconfig
# SPDX-License-Identifier: GPL-2.0-only
#
config RV_MON_IRQSTATE
	depends on RV
	depends on RV_MON_IRQ
	default y
	select HA_MON_EVENTS_IMPLICIT
	bool "irqstate monitor"
	help
	  Verify that generic hardirq and softirq context boundaries agree
	  with the execution context recorded in preempt count.

	  For further information, see:
	    Documentation/trace/rv/monitor_irq.rst
```
